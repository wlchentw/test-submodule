/*
 * Copyright (C) 2019 MediaTek Inc.
 *
 * This program is free software; you can redistribute it and/or modify
 * it under the terms of the GNU General Public License version 2 as
 * published by the Free Software Foundation.
 *
 * This program is distributed in the hope that it will be useful,
 * but WITHOUT ANY WARRANTY; without even the implied warranty of
 * MERCHANTABILITY or FITNESS FOR A PARTICULAR PURPOSE.
 * See http://www.gnu.org/licenses/gpl-2.0.html for more details.
 */
&rt9426 {
	rt,dtsi_version = <01 0704>;
	rt,battery_type = <4354>;
	rt,volt_source = <3>;		// 0:AP 1:FG_VBAT 2:FG_OCV; 3:FG_AV
	rt,temp_source = <1>;		// 0:AP 1:FG_TEMP 2:FG_INTT; 3:FG_AT
	rt,curr_source = <2>;		// 0:AP 1:FG_CURR 2:FG_AI

	rt,offset_interpolation_order = <2 2>;
	rt,soc_offset_size = <2 1>;
	rt,soc_offset_data = < 0 250 0 1000 250 0>;
	rt,extreg_size = <26>;
	rt,extreg_data = <
		0x2 0x4E 0x2404
		0x5 0x46 0x4105
		0x5 0x4E 0x000A
		0x6 0x40 0x8843
		0x6 0x42 0x8224
		0x6 0x44 0xAD77
		0x6 0x48 0x332A
		0x6 0x4A 0x6852
		0x6 0x4C 0x6457
		0x6 0x4E 0x0918
		0x7 0x40 0x1830
		0x7 0x42 0x130F
		0x7 0x44 0x0F0F
		0x7 0x46 0x1B1B
		0x7 0x48 0x1218
		0x7 0x4A 0x0805
		0x7 0x4C 0x0208
		0x7 0x4E 0xFF02
		0x8 0x40 0x04F5
		0x8 0x42 0x0404
		0x8 0x44 0xDBDB
		0x8 0x46 0xA4CC
		0x8 0x48 0x8080
		0x8 0x4A 0xB280
		0x8 0x4C 0xA4B2
		0x8 0x4E 0x0081
		>; //Page /Address /Data
	rt,design_capacity = <1861>;
	rt,fcc = <1861>;
	rt,fg_fc_vth = <0x8A>;
	rt,fg_fc_ith = <0x1F>;
	rt,fg_fc_sth = <0x05>;
	rt,fg_fd_vth = <0xA3>;

	rt,fg_op_config = <0x7480 0x2200 0x3EFB 0x2000 0x0B7F>;
	rt,fg_otc_tth = <0x0064>;
	rt,fg_otc_chg_ith = <0x0B5F>;
	rt,fg_otd_tth = <0x0064>;
	rt,fg_otd_dchg_ith = <0x0B5F>;
	rt,fg_uvov_threshold = <0x00FF>;
	rt,fg_us_threshold = <0x00>;
	rt,fg_curr_db = <0x05>;

	rt,fg_ocv_table = <
		0x0013 0x49C0 0x5280 0x582F 0x5B9F 0x5BFE 0x5CCF 0x5DD8
		0x5EC6 0x5F7F 0x602A 0x60BF 0x61A8 0x63CD 0x65DD 0x6732
		0x6856 0x699E 0x6BA6 0x706D 0x2300 0x05AF 0x02A5 0x0064
		0x0036 0x0037 0x001D 0x002C 0x003F 0x0050 0x0085 0x006D
		0x0081 0x008B 0x008B 0x0092 0x0097 0x01E9 0x0013 0xFF80
		0x0000 0x0200 0x049A 0x0680 0x0E4D 0x17E6 0x281A 0x309A
		0x3600 0x39B3 0x3D33 0x474D 0x4F80 0x5466 0x589A 0x5D1A
		0x6400 0x6900 0x0007 0x002D 0x0061 0x0291 0x04C9 0x04A0
		0x08BA 0x05E0 0x040B 0x032E 0x01EC 0x025B 0x01FD 0x01D7
		0x01D7 0x01C2 0x01B2 0x0086 0x5117 0x0000 0x0000 0x0000
		>;
};
