## BSP/meta/meta-mediatek-mt8110/conf/machine/aud8110m1-emmc.conf
```bitbake
#@TYPE: Machine
#@NAME:MT8110
#@DESCRIPTION: Machine configuration for mt8110

# For building codes by aarch64 mode (default 64-bit mode).
# DEFAULTTUNE ?= "aarch64"
# TUNE_CCARGS .= "${@bb.utils.contains('TUNE_FEATURES', 'aarch64', ' -mcpu=cortex-a72.cortex-a53+crypto', '', d)}"
# TUNE_CCARGS .= "${@bb.utils.contains('TUNE_FEATURES', 'aarch64', ' -mtune=cortex-a72.cortex-a53', '', d)}"
# include conf/machine/include/arm/arch-armv8.inc
# require conf/machine/include/arm/arch-armv7ve.inc
# require arch-arm64-tune-armv7ve-multilib.inc

# For building codes by aarch32 mode (32-bit mode) when all modules are ready for armv8.
# TUNE_CCARGS .= "${@bb.utils.contains('TUNE_FEATURES', 'aarch32', ' -mcpu=cortex-a72.cortex-a53', '', d)}"
# TUNE_CCARGS .= "${@bb.utils.contains('TUNE_FEATURES', 'aarch32', ' -mtune=cortex-a72.cortex-a53', '', d)}"
# TUNE_CCARGS .= "${@bb.utils.contains('TUNE_FEATURES', 'aarch32', ' -mfpu=crypto-neon-fp-armv8', '', d)}"
# TUNE_CCARGS .= "${@bb.utils.contains('TUNE_FEATURES', 'aarch32', ' -mfloat-abi=softfp', '', d)}"
# require conf/multilib.conf
# DEFAULTTUNE_virtclass-multilib-lib32 = "aarch32"

# For building codes by armv7ve mode (latest armv7 32-bit mode)
# TUNE_CCARGS .= "${@bb.utils.contains('TUNE_FEATURES', 'armv7ve', ' -mcpu=cortex-a72.cortex-a53', '', d)}" # Fine tune mcpu in the future. 
# TUNE_CCARGS .= "${@bb.utils.contains('TUNE_FEATURES', 'armv7ve', ' -mtune=cortex-a72.cortex-a53', '', d)}"
# require conf/multilib.conf
# DEFAULTTUNE_virtclass-multilib-lib32 = "armv7vehf-neon-vfpv4"

# For building codes to sync with other projects.
DEFAULTTUNE ?= "cortexa7-neon"
include conf/machine/include/tune-cortexa7.inc

# project
MTK_PROJECT = "aud8110m1-emmc"
TARGET_PLATFORM = "mt8110"
TARGET_PLATFORM_FLAVOR = "mt8110"
PRJ_FILENAME = "${MTK_PROJECT}"
COMPLIST = "${LINUX_KERNEL}"
LINUX_KERNEL = "linux-4.9.77"
PLATFORM_CHIP="MT8110"
PLATFORM="${TARGET_PLATFORM}"

# LK
LK_PROJECT = "${MTK_PROJECT}"
FULL_PROJECT = "full_${MTK_PROJECT}"
PREFERRED_VERSION_lk = "2.0.0"
BOOTDEV_TYPE = "emmc"

# secure boot
SECURE_BOOT_ENABLE = "yes"
MTK_KEY_DIR = "${TOPDIR}/../meta/meta-mediatek-mt8110/conf/machine/keys"
SBC_KEY = "sbc_key"
VERIFIED_KEY = "verified_key"
MTEE_KEY = "mtee_key"
FORCE_DISABLE_DM_VERITY = "yes"
FORCE_DISABLE_TEE_ENCRYPTION = "yes"
ENABLE_ROOTFS_CHECK = "no"

FIT_LK_IMAGE = "no"
LK_LOAD_OFFSET = "0x1000"
LK_LOADADDRESS = "0x201000"
LK_ENTRYPOINT = "0x201000"
LK_MAX_SIZE = "0x3d000"

# Kernel
KERNEL_ARCH = "arm"
PREFERRED_PROVIDER_virtual/kernel = "linux-mtk-extension"
PREFERRED_VERSION_linux-mtk-extension ?= "4.9%"
KERNEL_IMAGETYPE = "fitImage"
KBUILD_DEFCONFIG = "aud8110m1-emmc_defconfig"
KERNEL_DEVICETREE = "mediatek/aud8110m1-emmc.dtb"
DTB_LOADADDRESS = "0x44000000"
KERNEL_COMPRESS = "none"
OLDEST_KERNEL = "3.18"
MACHINE_ESSENTIAL_EXTRA_RRECOMMENDS += "kernel-modules"
LINUXLIBCVERSION = "4.9"

# LOADER ENTRYPOINT, LOADADDRESS
UBOOT_ENTRYPOINT = "0x40008000"
UBOOT_LOADADDRESS = "0x40008000"

#u-boot
UBOOT_BUILD_DEFCONFIG = "mt8110_m1_emmc_defconfig"
UBOOT_COMPRESS = "none"
UBOOT_FIT_LOADADDRESS = "0x44e00000"
UBOOT_FIT_ENTRYPOINT = "0x44e00000"
BL33_ARCH = "arm"

# LOADER ENTRYPOINT, LOADADDRESS
RECOVERY_RAMDISK_LOADADDRESS = "0x45000000"

# Scatter File
SCATTER_PROJECT = "aud8110m1-emmc"

# boot mode
MTK_SPI_NOR_SUPPORT = "no"

# Trustzone
TZ_PROJECT = "mt8512"
TZ_PLATFORM = "mt8512"
ATF_SUPPORT = "yes"
PREFERRED_VERSION_atf = "1.6"
ATF_INSTALL_MODE = "debug"
MTK_MACH_TYPE = "mt8512"
TRUSTZONE_HEADER = "fit"
TRUSTZONE_ENTRYPOINT = "0x43001000"
TRUSTZONE_LOADADDRESS = "0x43001000"
TRUSTZONE_COMPRESS = "none"
TRUSTEDOS_ENTRYPOINT = "0x43030000"
TRUSTEDOS_LOADADDRESS = "0x43030000"
TRUSTEDOS_SIZE = "0x3d0000"
TRUSTEDOS_SHMEM_SIZE = "0x100000"
TEE_SUPPORT = "optee"
TEE_ARCH = "arm64"
TEE_TOOLCHAIN = "${TOPDIR}/../prebuilt/toolchain/aarch64-linux-android-4.9/bin/aarch64-linux-android-"

# Image FS
IMAGE_FSTYPES ?= "ext4"
IMAGE_ROOTFS_ALIGNMENT = "4"
EXTRA_IMAGEDEPENDS += "lk trustzone scatter fbtool-native flashtool-native u-boot"
SERIAL_CONSOLE = "921600 ttyS0"

MKUBIFS_USRDATA_IMAGE_SZ="2048"
MKEXT4_USRDATA_CNT="20480"

COMBO_CHIP_ID="mt6631"
BT_LAUNCHER_SUFFIX="6627_"
BT_NVRAM_ENABLE="yes"
GATT_TEST="yes"
SUPPORT_MTK_BT="true"

# Userdata
MKUBIFS_USRDATA_IMAGE_SZ="2048"
MKEXT4_USRDATA_CNT="20480"

# Keypad service
KEYPAD_SERVICE_ENABLE = "true"
```

## BSP/src/bsp/u-boot/board/mediatek/mt8112_p1/Kconfig
```kconfig
if TARGET_MT8112_P1

config SYS_BOARD
	default "mt8112_p1"

config SYS_CONFIG_NAME
	default "mt8112_p1"


config MTK_BROM_HEADER_INFO
	string
	default "media=nor"

endif
```

## BSP/src/bsp/u-boot/board/mediatek/mt8113_lp1/Kconfig
```kconfig
if TARGET_MT8113_LP1

config SYS_BOARD
	default "mt8113_lp1"

config SYS_CONFIG_NAME
	default "mt8113_lp1"

config MTK_BROM_HEADER_INFO
	string
	default "media=nor"

endif
```

## BSP/src/bsp/u-boot/board/mediatek/mt8113_p1/Kconfig
```kconfig
if TARGET_MT8113_P1

config SYS_BOARD
	default "mt8113_p1"

config SYS_CONFIG_NAME
	default "mt8113_p1"

config MTK_BROM_HEADER_INFO
	string
	default "media=nor"

endif
```

## BSP/src/kernel/linux/v4.9/drivers/input/touchscreen/focaltech/Kconfig
```kconfig
config  TOUCH_FOCALTECH
    tristate "focaltech touch driver,I2C driver"
    depends on I2C
    default n
    help
        It is a android driver to support focaltech touchscreen

config FOCALTECH_EREA_REPORT_SUPPORT
    tristate "driver support report erea"
    depends on TOUCH_FOCALTECH
    default n
    help
        if we need support erea,turn on this.

config USE_PINCTRL_GPIO
    tristate "driver use pinctrl gpio"
    depends on TOUCH_FOCALTECH
    default n
    help
        if we need support pinctrl,turn on this.
```

## BSP/src/kernel/linux/v4.9/drivers/misc/mediatek/cfa/Kconfig
```kconfig
config MTK_CFA
	tristate "build cfa driver"
	help
	    This cfa module is used for eink color handle.
		    CFA will convert RGB format input picture to electronic conversion signal,
		    which will drive ink screen show input picture.
```

## BSP/src/kernel/linux/v4.9/drivers/misc/mediatek/hwtcon/Kconfig
```kconfig
config MTK_HWTCON
	tristate "build HWTCON driver"
	help
	This HWTCON module is used for drive electronic ink screen show picture.
		HWTCON convert Y4 format input picture to electronic signal,
		which will drive ink screen show input picture.
```

## BSP/src/kernel/linux/v4.9/drivers/ntx/Kconfig
```kconfig
#
# Netronix platform support 
#
config NTX_PLATFORM
	bool "Netronix platform support"
	---help---
	  Enable support for Netronix platform .

	  Say Y when you have netronix platform environment.
```
